/* ─────────────────────────────────────────────────────────────
   StormCloud — generated by Bolt Bench

   Five of the seven files here are regenerated wholesale every time you
   export from the bench: layout.h, tuning.h, storm.h, strip.h and this
   one. config.h and controls.h are yours and are never overwritten —
   pins, logging, palettes and the controls live there.
   ───────────────────────────────────────────────────────────── */
#include "storm.h"
#include "strip.h"
#include "controls.h"

void setup() {
#if STORM_LOG
  Serial.begin(STORM_LOG_BAUD);
  uint32_t waited = millis();                 // USB CDC needs a moment to enumerate,
  while (!Serial && millis() - waited < 1500) { }   // but never hang without a host
#endif
  stripBegin();
  controlsStart();                      // palette, speeds and level at their start values
  random16_set_seed(0x1337);            // same seed the bench previewed
  logBoot();
  controlsBegin();
  chaosBegin();
}

void loop() {
  controlsUpdate(millis());

  frameNo++;
  fill_solid(leds, NUM_LEDS, CRGB::Black);
  if (g_hold) {
    renderHold();                  // storm paused: its clock does not advance
  } else {
    uint32_t now = stormClock();   // virtual: the speed setting stretches this
    chaosPoll(millis(), now);      // button in real time, strikes in storm time
    renderAmbient(cloudClock());   // the cloud's shimmer, on its own speed
    scheduleStrikes(now);
    for (uint8_t i = 0; i < MAX_STRIKES; i++) renderStrike(strikes[i], now);
  }

  uint32_t drawmW = stripShow(leds, frameBrightness());
  logDashboard(millis(), drawmW);  // wall-clock, not the speed-scaled storm clock
}
