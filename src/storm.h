/* Storm engine, generated by Bolt Bench — overwritten on export. */
#pragma once
#include <FastLED.h>
#include "config.h"
#include "layout.h"
#include "tuning.h"

CRGB leds[NUM_LEDS];

/* ── palette ────────────────────────────────────────────────── */
/* Both endpoints of the heat ramp, resolved once per frame rather than
   per pixel, so addLed() stays three mix8 and three scale8. */
CRGB coolC, hotC;

/* Runtime copies of the tuning.h values, seeded from them at boot. Anything
   the controls can move has to live in RAM rather than as a #define;
   everything else stays a compile-time constant.

   Speed and level run in steps rather than continuously, ten of each, set
   from the keyboard (controls.h). Level is 0..100% in ninths (0, 11, 22 ...
   100); both brightness now and storm severity later read g_level, so they
   share one set of steps. */
#define LEVEL_STEPS   10
#define SPEED_STEPS   10

uint8_t  g_hue    = HUE;
uint8_t  g_sat    = SAT;
uint8_t  g_hotHue = HOT_HUE;
uint8_t  g_hotSat = HOT_SAT;
uint8_t  g_bright = 0;                 // resolved in setup()
uint8_t  g_level  = LEVEL_STEPS - 1;   // 0..LEVEL_STEPS-1, the level step
uint8_t  g_trim   = TRIM;              // brightness trim of the live palette
uint8_t  g_palette = 0;                // index into PALETTES[] in config.h

/* Scheduler settings the chaos button borrows for a few seconds. Seeded from
   tuning.h; the severity crossfade will drive these too when it lands. */
uint16_t g_gapMin    = GAP_MIN;
uint16_t g_gapMax    = GAP_MAX;
uint8_t  g_dblChance = DBL_CHANCE;
uint8_t  g_chaos     = 0;              // 0..255, position in the chaos envelope
uint16_t g_speedQ8 = 256;              // 8.8 fixed point; 256 = 1.00x
uint8_t  g_speed   = SPEED_STEPS / 2;  // 0..SPEED_STEPS-1, the speed step; 5 is 1.00x
uint16_t g_cloudQ8 = 256;              // the cloud's ambient shimmer, on its own clock
uint8_t  g_cloud   = SPEED_STEPS / 2;  // 0..SPEED_STEPS-1, the cloud speed step

void updatePalette() {
  hsv2rgb_rainbow(CHSV(g_hue, g_sat,     255), coolC);
  hsv2rgb_rainbow(CHSV(g_hotHue, g_hotSat, 255), hotC);
}

/* The brightness this frame goes out at: the level setting's, raised toward
   the palette's ceiling while chaos rages, so level is ignored at the height
   of it. */
uint8_t frameBrightness() {
  uint8_t ceil8 = scale8(MASTER, g_trim);
  uint8_t head  = ceil8 > g_bright ? ceil8 - g_bright : 0;
  return g_bright + scale8(head, g_chaos);
}

/* ── clocks ─────────────────────────────────────────────────── */
/* Virtual clocks, not scaled millis(). Scaling millis() directly would
   teleport every strike in flight the instant the speed changed; these
   accumulate instead, so a speed change is smooth. It is the same thing
   the bench does with simTime += dt * speed.

   Two of them: the storm clock runs the strikes (and the cloud's flash in
   sympathy, which belongs to the strike), the cloud clock runs only the
   cloud's ambient shimmer. At equal speeds they read the same, which is
   what the bench previews. */
struct VirtualClock {
  uint64_t q8 = 0;                     // elapsed ms in 8.8, so slow speeds keep their fractions
  uint32_t lastReal = 0;
};

static uint32_t tick(VirtualClock &c, uint16_t speedQ8) {
  uint32_t real = millis();
  uint32_t dt = real - c.lastReal;
  c.lastReal = real;
  if (dt > 100) dt = 100;              // never fast-forward through a stall
  c.q8 += (uint64_t)dt * speedQ8;
  return (uint32_t)(c.q8 >> 8);
}

VirtualClock stormVClock, cloudVClock;
uint32_t stormClock() { return tick(stormVClock, g_speedQ8); }
uint32_t cloudClock() { return tick(cloudVClock, g_cloudQ8); }

/* ── helpers ────────────────────────────────────────────────── */
static inline uint8_t mix8(uint8_t a, uint8_t b, uint8_t amt) {
  return a + (uint8_t)(((int16_t)(b - a) * (int16_t)amt) >> 8);
}
static inline uint8_t dist8(int16_t dx, int16_t dy) {
  uint16_t ax = dx < 0 ? -dx : dx, ay = dy < 0 ? -dy : dy;
  uint16_t hi = ax > ay ? ax : ay, lo = ax > ay ? ay : ax;
  uint16_t d = hi + ((lo * 85) >> 8);
  return d > 255 ? 255 : (uint8_t)d;
}
// stateless per-pixel noise: the same pixel flickers the same way each frame
static inline uint8_t hash8(uint16_t a, uint16_t b) {
  uint32_t h = ((uint32_t)a * 73856093UL) ^ ((uint32_t)b * 19349663UL);
  h ^= h >> 13;
  return (uint8_t)((h * 2654435761UL) >> 24);
}
static inline uint16_t rndR(uint16_t lo, uint16_t hi) {
  return hi <= lo ? lo : lo + random16(hi - lo);
}

/* ── strike model ───────────────────────────────────────────── */
struct Stroke { uint16_t at; uint16_t dur; uint8_t b; uint8_t upTo; };
struct Strike {
  bool     active;
  uint8_t  seg;
  uint32_t t0;
  uint16_t leaderMs;
  uint8_t  nStrokes;
  Stroke   strokes[MAX_STROKES];
  uint16_t lastEnd;
  uint16_t glowMs;
  uint16_t total;
  uint8_t  ox, oy;
  uint8_t  forkMask;    // bit k set = restrike k travels into the forks
  uint8_t  rumbleSeed;
};
Strike strikes[MAX_STRIKES];
uint32_t nextStrikeAt = 700;
uint16_t frameNo = 0;

void makeStrike(uint8_t slot, uint8_t segIdx, uint32_t t0) {
  Strike &s = strikes[slot];
  Segment seg; memcpy_P(&seg, &SEGMENTS[segIdx], sizeof(Segment));
  s.active = true; s.seg = segIdx; s.t0 = t0;
  s.leaderMs = rndR(LEAD_MIN, LEAD_MAX + 1);
  s.nStrokes = rndR(STRK_MIN, STRK_MAX + 1);
  if (s.nStrokes > MAX_STROKES) s.nStrokes = MAX_STROKES;
  uint16_t t = s.leaderMs;
  for (uint8_t k = 0; k < s.nStrokes; k++) {
    uint16_t dur = rndR(DUR_MIN, DUR_MAX + 1);
    bool partial = (k > 0) && (random8() < PARTIAL);
    s.strokes[k].at   = t;
    s.strokes[k].dur  = dur;
    s.strokes[k].b    = (k == 0) ? 255 : (uint8_t)rndR(110, 256);
    s.strokes[k].upTo = partial ? (uint8_t)rndR(90, 210) : 255;
    t += dur + rndR(RGAP_MIN, RGAP_MAX + 1);
  }
  s.lastEnd = s.strokes[s.nStrokes - 1].at + s.strokes[s.nStrokes - 1].dur;
  uint16_t g = GLOW_MS + rndR(0, 200);
  s.glowMs = g > 120 ? g - 80 : 40;      // GLOW_MS - 80 to + 119, never under 40
  s.total  = s.lastEnd + (s.glowMs > CLOUD_MS ? s.glowMs : CLOUD_MS);
  s.forkMask = 1;                       // the return stroke always forks
  for (uint8_t k = 1; k < s.nStrokes; k++)
    if (random8() < FORK_FOLLOW) s.forkMask |= (1 << k);
  s.ox = seg.ox; s.oy = seg.oy;
  s.rumbleSeed = random8();
}

int8_t freeSlot() {
  for (uint8_t i = 0; i < MAX_STRIKES; i++) if (!strikes[i].active) return i;
  return -1;
}
void trigger(uint8_t segIdx, uint32_t at) {
  int8_t slot = freeSlot();
  if (slot < 0) {
#if STORM_LOG
    Segment sg; memcpy_P(&sg, &SEGMENTS[segIdx], sizeof(Segment));
    LOG("[storm] DROPPED %s — all %u strike slots busy\n", sg.name, (unsigned)MAX_STRIKES);
#endif
    return;
  }
  makeStrike(slot, segIdx, at);
}

/* ── per-pixel accumulate ───────────────────────────────────── */
void addLed(uint16_t i, uint8_t bright, uint8_t heat, uint16_t pos, uint16_t len) {
  if (i >= NUM_LEDS || bright == 0) return;
  if (len > 1 && TAPER) {
    uint8_t t = (uint8_t)((uint32_t)pos * 255 / len);
    bright = qsub8(bright, scale8(bright, scale8(t, TAPER)));
    if (!bright) return;
  }
  leds[i].r = qadd8(leds[i].r, scale8(mix8(coolC.r, hotC.r, heat), bright));
  leds[i].g = qadd8(leds[i].g, scale8(mix8(coolC.g, hotC.g, heat), bright));
  leds[i].b = qadd8(leds[i].b, scale8(mix8(coolC.b, hotC.b, heat), bright));
}

/* ── channel envelope: intensity + heat (white ↔ blue) ──────── */
void envelope(const Strike &s, uint16_t e, uint8_t &env, uint8_t &heat, uint8_t &upTo, int8_t &idx) {
  env = 0; heat = 0; upTo = 255; idx = -1;
  for (uint8_t k = 0; k < s.nStrokes; k++) {
    const Stroke &st = s.strokes[k];
    if (e >= st.at && e < (uint16_t)(st.at + st.dur)) {
      uint8_t p = (uint8_t)((uint32_t)(e - st.at) * 255 / st.dur);
      uint8_t v = scale8(st.b, qsub8(255, scale8(p, 150)));
      if (v > env) { env = v; heat = 255; upTo = st.upTo; idx = (int8_t)k; }
    }
  }
  if (e > s.lastEnd) {
    uint32_t q = (uint32_t)(e - s.lastEnd) * 255 / s.glowMs;
    uint8_t p = q > 255 ? 255 : (uint8_t)q;
    uint8_t inv = qsub8(255, p);
    uint8_t fall = scale8(scale8(inv, inv), 150);
    if (fall > env) { env = fall; heat = inv; upTo = 255; idx = -1; }  // afterglow: all channels
  }
}

/* One channel of the strike tree.

   A fork's leader starts when the parent's leader head reaches the attachment
   point, and travels at the same propagation velocity (same pixels per ms), so
   a branch and its trunk arrive at about the same moment — which is what real
   forked lightning does. Depth is capped at 3. */
void renderChannel(const Strike &s, uint16_t e, uint8_t segIdx,
                   uint16_t leaderStart, uint16_t leaderDur, uint8_t dim, uint8_t depth,
                   uint8_t env, uint8_t heat, uint8_t upTo, int8_t sidx) {
  if (depth > 3) return;
  Segment seg; memcpy_P(&seg, &SEGMENTS[segIdx], sizeof(Segment));
  uint16_t start = seg.start, len = seg.len;
  if (len < 1) return;

  if (e >= leaderStart && (uint16_t)(e - leaderStart) < leaderDur) {   // stepped leader
    uint16_t le = e - leaderStart;
    uint16_t head = (uint16_t)(((uint32_t)le * len) / leaderDur);
    for (uint16_t i = 0; i <= head && i < len; i++) {
      // fades TRAIL per pixel behind the head; wider than 8 bits on purpose,
      // so a long trail runs out at zero instead of wrapping back to bright
      uint16_t fade = (head - i) * TRAIL;
      uint8_t b = fade < 240 ? 240 - fade : 0;
      if (b) addLed(start + i, scale8(b, dim), 200, i, len);
    }
  }

  bool partake = (depth == 0) || (sidx < 0) || ((s.forkMask >> sidx) & 1);
  if (env && partake) {                                   // return + restrikes
    uint16_t lim = (uint16_t)(((uint32_t)len * upTo) >> 8) + 1;
    if (lim > len) lim = len;
    for (uint16_t i = 0; i < lim; i++) {
      uint8_t flick = qsub8(255, hash8(start + i, frameNo >> 1) >> 3);
      addLed(start + i, scale8(scale8(env, flick), dim), heat, i, len);
    }
  }

  for (uint8_t c = 0; c < NUM_SEGMENTS; c++) {            // recurse into forks
    Segment ch; memcpy_P(&ch, &SEGMENTS[c], sizeof(Segment));
    if (ch.parent != (int8_t)segIdx || ch.len < 1) continue;
    uint16_t cStart = leaderStart + (uint16_t)(((uint32_t)leaderDur * ch.forkAt) >> 8);
    uint16_t cDur = (uint16_t)(((uint32_t)leaderDur * ch.len) / len);
    if (cDur < 4) cDur = 4;
    renderChannel(s, e, c, cStart, cDur, scale8(dim, FORK_DIM), depth + 1, env, heat, upTo, sidx);
  }
}

void renderStrike(Strike &s, uint32_t now) {
  if (!s.active) return;
  if (now < s.t0) return;
  uint32_t el = now - s.t0;
  if (el > s.total) { s.active = false; return; }
  uint16_t e = (uint16_t)el;

  Segment seg; memcpy_P(&seg, &SEGMENTS[s.seg], sizeof(Segment));
  if (seg.len < 1) return;

  uint8_t env, heat, upTo; int8_t sidx;
  envelope(s, e, env, heat, upTo, sidx);
  renderChannel(s, e, s.seg, 0, s.leaderMs, 255, 0, env, heat, upTo, sidx);

  // the cloud lights in sympathy, by distance from the channel root
  uint8_t glowP = 0;
  if (e > s.lastEnd) {
    uint32_t q = (uint32_t)(e - s.lastEnd) * 255 / CLOUD_MS;
    glowP = q > 255 ? 255 : (uint8_t)q;
  }
  uint8_t cenv = env;
  if (glowP) {
    uint8_t inv = qsub8(255, glowP);
    uint8_t fall = scale8(inv, inv);
    if (fall > cenv) cenv = fall;
  }
  cenv = scale8(cenv, CLOUD_FLASH);
  if (cenv > 1) {
    uint8_t rum = RUMBLE ? scale8(RUMBLE, sin8((uint8_t)((now * 3) >> 4) + s.rumbleSeed)) : 0;
    uint8_t cheat = qsub8(heat, scale8(glowP, 200));
    for (uint8_t g = 0; g < NUM_SEGMENTS; g++) {
      Segment cs; memcpy_P(&cs, &SEGMENTS[g], sizeof(Segment));
      if (cs.isBolt) continue;
      for (uint16_t j = cs.start; j < cs.start + cs.len; j++) {
        int16_t dx = (int16_t)pgm_read_byte(&LED_X[j]) - (int16_t)s.ox;
        int16_t dy = (int16_t)pgm_read_byte(&LED_Y[j]) - (int16_t)s.oy;
        uint8_t atten = qsub8(255, scale8(dist8(dx, dy), CLOUD_SPREAD));
        if (!atten) continue;
        uint8_t v = scale8(cenv, atten);
        if (rum) v = qsub8(v, scale8(v, scale8(rum, hash8(j, s.rumbleSeed))));
        if (v) addLed(j, v, cheat, 0, 1);
      }
    }
  }
}

void renderAmbient(uint32_t now) {
  if (!AMB_LEVEL) return;
  uint8_t t1 = (uint8_t)((now * AMB_SPEED) / 64);
  uint8_t t2 = (uint8_t)((now * AMB_SPEED) / 160);
  for (uint8_t g = 0; g < NUM_SEGMENTS; g++) {
    Segment cs; memcpy_P(&cs, &SEGMENTS[g], sizeof(Segment));
    if (cs.isBolt) continue;
    for (uint16_t j = cs.start; j < cs.start + cs.len; j++) {
      uint8_t a = sin8(t1 + (uint8_t)(j * 5));
      uint8_t b = sin8(t2 - (uint8_t)(j * 11) + 64);
      uint8_t v = scale8(scale8(a, b), AMB_LEVEL);
      if (v) addLed(j, v, 40, 0, 1);
    }
  }
}

/* ── dashboard ──────────────────────────────────────────────── */
/* One line, rewritten when the state a person would notice changes, and
   refreshed on a slow timer while it does not. Not a log: no scrollback of
   every strike and every key press, just the current picture. Only DROPPED
   still prints on its own, because it is a fault rather than a state.

   Grouped by what you are looking for: the three controls first, then the
   strike in flight, then the diagnostics. */

/* A step as a percentage of the range, the way a person counts presses,
   rather than the multiplier or brightness it maps to. */
static void stepPercent(char *buf, size_t n, uint8_t idx, uint8_t steps) {
  snprintf(buf, n, "%u%%%s", (unsigned)((idx + 1) * 100 / steps),
           idx == 0 ? " (min)" : idx == steps - 1 ? " (max)" : "");
}

/* drawmW is what the strip drew for the frame just sent, from stripShow(). */
void logDashboard(uint32_t realNow, uint32_t drawmW) {
#if STORM_LOG
  static char     lastLine[160] = "";
  static uint32_t lastAt = 0, frames = 0, peakmW = 0, fpsAt = 0, fps = 0;

  frames++;
  if (drawmW > peakmW) peakmW = drawmW;
  if (realNow - fpsAt >= 1000) {
    fps = frames * 1000UL / (realNow - fpsAt ? realNow - fpsAt : 1);
    frames = 0; fpsAt = realNow;
  }

  // A strike lights its whole tree, so the root channel is the summary; forks
  // never fire on their own. Overlapping strikes show as "name +N".
  char chan[28];
  uint8_t nActive = 0; int8_t newest = -1; uint32_t newestT = 0;
  for (uint8_t i = 0; i < MAX_STRIKES; i++) {
    if (!strikes[i].active) continue;
    nActive++;
    if (newest < 0 || strikes[i].t0 >= newestT) { newest = i; newestT = strikes[i].t0; }
  }
  if (newest < 0) snprintf(chan, sizeof chan, "_");
  else {
    Segment sg; memcpy_P(&sg, &SEGMENTS[strikes[newest].seg], sizeof(Segment));
    if (nActive > 1) snprintf(chan, sizeof chan, "%s +%u", sg.name, (unsigned)(nActive - 1));
    else             snprintf(chan, sizeof chan, "%s", sg.name);
  }

  char spd[12], cld[12], lvl[12];
  stepPercent(spd, sizeof spd, g_speed, SPEED_STEPS);
  stepPercent(cld, sizeof cld, g_cloud, SPEED_STEPS);
  if (g_chaos) snprintf(lvl, sizeof lvl, "CHAOS");
  else         stepPercent(lvl, sizeof lvl, g_level, LEVEL_STEPS);

  char line[160];
  snprintf(line, sizeof line,
           "palette: %-10s  speed: %-10s  cloud: %-10s  level: %-10s | strike: %-16s",
           PALETTES[g_palette].name, spd, cld, lvl, chan);

  bool changed = strcmp(line, lastLine) != 0;
  bool due     = (realNow - lastAt) >= STORM_LOG_STATS;
  if (!((changed && realNow - lastAt >= STORM_LOG_MIN_MS) || due)) return;

  strncpy(lastLine, line, sizeof lastLine - 1);
  lastLine[sizeof lastLine - 1] = 0;
  lastAt = realNow;

  LOG("%s | fps: %3lu  mA: %4lu\n", line, (unsigned long)fps, (unsigned long)(peakmW / 5));
  peakmW = 0;                    // peak is per line, not since boot
#else
  (void)realNow; (void)drawmW;
#endif
}

/* ── scheduler ──────────────────────────────────────────────── */
/* Root channels only: forks are never struck directly, they light because
   their parent did. Draws from random16() in the same order as the bench, so
   the same seed replays the same storm. */
void scheduleStrikes(uint32_t now) {
  if (now < nextStrikeAt) return;

  uint8_t bolts[NUM_SEGMENTS], n = 0;
  for (uint8_t i = 0; i < NUM_SEGMENTS; i++) {
    Segment sg; memcpy_P(&sg, &SEGMENTS[i], sizeof(Segment));
    if (sg.isBolt && sg.parent < 0 && sg.len > 1) bolts[n++] = i;
  }
  if (n) {
    uint8_t pick = rndR(0, n);
    trigger(bolts[pick], now);
    if (random8() < g_dblChance && n > 1) {          // a second, different channel
      uint8_t other = rndR(0, n);
      if (other == pick) other = (other + 1) % n;
      uint16_t lag = rndR(40, CLUSTER_MS + 1);
      trigger(bolts[other], now + lag);
    }
  }
  nextStrikeAt = now + rndR(g_gapMin, g_gapMax + 1);
}

/* ── hold ───────────────────────────────────────────────────── */
/* One segment lit steady, everything else dark, for checking the wiring
   against the bench's routing. The storm is paused rather than hidden: its
   clock stops, and it resumes from a clear sky when hold ends. */
bool    g_hold    = false;
uint8_t g_holdSeg = 0;                 // index into SEGMENTS[]

static void logHold() {
  if (!g_hold) { LOG("[hold]  off\n"); return; }
  Segment sg; memcpy_P(&sg, &SEGMENTS[g_holdSeg], sizeof(Segment));
  LOG("[hold]  %u %s, pixels %u-%u (%u)\n", (unsigned)g_holdSeg, sg.name,
      (unsigned)sg.start, (unsigned)(sg.start + sg.len - 1), (unsigned)sg.len);
}

void holdSet(bool on) {
  g_hold = on;
  g_holdSeg = 0;
  for (uint8_t i = 0; i < MAX_STRIKES; i++) strikes[i].active = false;
  logHold();
}

void holdSelect(uint8_t seg) {
  if (seg >= NUM_SEGMENTS) {
    LOG("[hold]  no segment %u; 0-%u\n", (unsigned)seg, (unsigned)(NUM_SEGMENTS - 1));
    return;
  }
  g_holdSeg = seg;
  logHold();
}

/* In the palette's peak colour, so it reads near white whatever the palette. */
void renderHold() {
  Segment sg; memcpy_P(&sg, &SEGMENTS[g_holdSeg], sizeof(Segment));
  for (uint16_t j = sg.start; j < sg.start + sg.len && j < NUM_LEDS; j++) leds[j] = hotC;
}

/* ── boot banner ────────────────────────────────────────────── */
/* Why the board last restarted. BROWNOUT means the 5 V rail sagged: almost
   always a strike drawing more than the supply gives (see LED_MAX_MA). */
static const char *resetReason() {
  switch (esp_reset_reason()) {
    case ESP_RST_POWERON:  return "power on";
    case ESP_RST_EXT:      return "reset pin";
    case ESP_RST_SW:       return "software";
    case ESP_RST_PANIC:    return "CRASH";
    case ESP_RST_INT_WDT:
    case ESP_RST_TASK_WDT:
    case ESP_RST_WDT:      return "WATCHDOG";
    case ESP_RST_BROWNOUT: return "BROWNOUT";
    default:               return "other";
  }
}

void logBoot() {
#if STORM_LOG
  LOG("\n[storm] StormCloud ready — %u px, %u segments, pin %u, master %u\n",
      (unsigned)NUM_LEDS, (unsigned)NUM_SEGMENTS, (unsigned)LED_PIN, (unsigned)MASTER);
  LOG("[storm] last reset: %s\n", resetReason());
  LOG("[storm] %-16s %5s %5s %6s  %s\n", "segment", "start", "len", "role", "attachment");
  for (uint8_t i = 0; i < NUM_SEGMENTS; i++) {
    Segment sg; memcpy_P(&sg, &SEGMENTS[i], sizeof(Segment));
    if (sg.parent < 0) {
      LOG("[storm] %-16s %5u %5u %6s  %s\n", sg.name, (unsigned)sg.start, (unsigned)sg.len,
          sg.isBolt ? "bolt" : "cloud", sg.isBolt ? "root channel" : "-");
    } else {
      Segment pa; memcpy_P(&pa, &SEGMENTS[sg.parent], sizeof(Segment));
      LOG("[storm] %-16s %5u %5u %6s  off %s at %u%%\n", sg.name, (unsigned)sg.start,
          (unsigned)sg.len, "fork", pa.name, (unsigned)(sg.forkAt * 100 / 255));
    }
  }
  LOG("[storm] palette hue=%u/%u sat=%u/%u -> cool #%02X%02X%02X hot #%02X%02X%02X\n",
      (unsigned)g_hue, (unsigned)g_hotHue, (unsigned)g_sat, (unsigned)g_hotSat,
      coolC.r, coolC.g, coolC.b, hotC.r, hotC.g, hotC.b);
  LOG("[storm] frame buffer %u B, strike pool %u B, segment table %u B\n\n",
      (unsigned)sizeof(leds), (unsigned)sizeof(strikes), (unsigned)sizeof(SEGMENTS));
#endif
}
